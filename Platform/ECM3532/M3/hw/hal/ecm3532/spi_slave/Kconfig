## Platform/ECM3532/M3/hw/hal/ecm3532/spi_slave/Kconfig
```kconfig
menu "SPI Slave HAL Settings"

config SPI_0_SLAVE
    bool "Enable SPI 0 slave"
    depends on !I2c_0 && !SPI_0_MASTER
    default y

choice SPI_SLAVE_CLK_PHASE
    prompt "SPI Slave Clock Phase"
    config LEADING_EDGE
        bool "leading edge"
    config TRAILING_EDGE
        bool "traling edge"
endchoice
config SPI_SLAVE_CLK_PHASE
    int
    default 0 if LEADING_EDGE
    default 1 if TRAILING_EDGE

choice SPI_SLAVE_CLK_POLARITY
    prompt "SPI Slave Clock Polarity"
    config POSITIVE_CLOCK_POLARITY
        bool "positive clock polarity"
    config NEGATIVE_CLOCK_POLARITY
        bool "negative clock polarity"
endchoice
config SPI_SLAVE_CLK_POLARITY
    int
    default 0 if POSITIVE_CLOCK_POLARITY
    default 1 if NEGATIVE_CLOCK_POLARITY
endmenu
```

## Platform/ECM3532/M3/hw/power/ecm3532/Kconfig
```kconfig
menu "Power Management Setting"
comment "This enable's CVFS based on system load"

config PM_ENABLE
    bool "Enable Load based CVFS"
    default n
    select HAL_COMMON_TIMER
config PM_WFI_ONLY
    bool "PM LPM as WFI Only"
    depends on PM_ENABLE
    default n
config ENABLE_FRONT_PANEL
    bool "Enable Front Panel Req for Freq Counter"
    default n
    depends on ECM3532

if PM_ENABLE
orsource "src/Kconfig"
endif

config M3_INIT_FREQ
    int "M3 Default Init Frequency in MHz"
    range 20 100
    default 60
    depends on ECM3532

config DSP_INIT_FREQ
    int "DSP Default Init Frequency in MHz"
    range 20 39 if (M3_INIT_FREQ < 40)
    range 40 60 if (M3_INIT_FREQ >= 40 && M3_INIT_FREQ <= 60)
    range 61 100 if (M3_INIT_FREQ > 60 && M3_INIT_FREQ <= 100)
    default M3_INIT_FREQ


config PM_MON
    bool "CPU load monitor"
    default y
    depends on PM_ENABLE  && ECM3532

endmenu
```

## Platform/ECM3532/M3/hw/power/ecm3532/src/Kconfig
```kconfig
menu "DVFS Parameters"
comment "DVFS configrable parameters"
config MIN_M3_FREQ
	int "M3 Lowest Allowed Freq"
    depends on PM_ENABLE && ECM3532
	default 20
    range 20 60

config MAX_M3_FREQ
	int "M3 MAX Target Freq"
    depends on PM_ENABLE && ECM3532
	default 100
    range 20 100

menu "DVFS Threshold"

config DELTA_STEP_UP
    int "M3 Step Up delta"
    default 5
    range 3 20
    depends on PM_ENABLE && ECM3532

config DELTA_STEP_DOWN
    int "M3 Step Down delta"
    default 3
    range 3 20
    depends on PM_ENABLE && ECM3532

config LOAD_HIGH_THRESH
	int "CPU Load Step Up threshold"
    depends on PM_ENABLE && ECM3532
	default 80

config LOAD_CRIT_HIGH_THRESH
	int "CPU Load Critical High threshold"
    depends on PM_ENABLE && ECM3532
	default 90

config LOAD_LOW_THRESH
	int "CPU Load Step Down threshold"
    depends on PM_ENABLE && ECM3532
	default 75

config STEP_UP_DEBOUNCE
	int "Debounce count of Load for step up"
    depends on PM_ENABLE && ECM3532
	default 2

config STEP_DOWN_DEBOUNCE
	int "Debounce count of Load for step down"
    depends on PM_ENABLE && ECM3532
	default 2

endmenu

endmenu
```

## Platform/ECM3532/M3/hw/sensor_drv/Kconfig
```kconfig
menu "Sensor Driver Menu"

config LSM6DSL_M3
    bool "LSM6DSL I2C accelerometer and gyroscope Chip"
    depends on SENSOR_MANAGER && (HAL_I2C || HAL_COMMON_I2C) && (!RPC)
    default n
    if LSM6DSL_M3
        rsource "lsm6dsl/Kconfig"
    endif

config LSM6DSL_DSP
    bool "DSP Driver for LSM6DSL I2C accelerometer and gyroscope Chip"
    depends on SENSOR_MANAGER && RPC
    default n
    if LSM6DSL_DSP
        rsource "lsm6dsl_dsp/Kconfig"
    endif

config LSM6DSL_FFT_DSP
    bool "DSP Composite Driver for FFT using LSM6DSL"
    depends on SENSOR_MANAGER && RPC
    default n
    if LSM6DSL_FFT_DSP
        rsource "lsm6dsl_fft_dsp/Kconfig"
    endif

config STUB_DRV
	bool "Sensor manager stub driver for interface testing"
    depends on SENSOR_MANAGER
    default n
    if STUB_DRV
        rsource "stub_drv/Kconfig"
    endif

config ICM20602_M3
    bool "ICM20602 I2C accelerometer and gyroscope Chip"
    depends on SENSOR_MANAGER && (HAL_I2C || HAL_COMMON_I2C) && (!RPC)
    default n
    if ICM20602_M3
        rsource "icm20602/Kconfig"
    endif


endmenu
```

## Platform/ECM3532/M3/hw/sensor_drv/icm20602/Kconfig
```kconfig
menu "ICM20602 configuration"
config ICM20602_NAME
    string "Device Name String"
    default "icm20602"
config ICM20602_GPIO_IRQ
    int "ICM20602 GPIO Irq Number"
    default 25

endmenu
```

## Platform/ECM3532/M3/hw/sensor_drv/lsm6dsl/Kconfig
```kconfig
menu "LSM6DSL configuration"
config LSM6DSL_NAME
    string "Device Name String"
    default "lsm6dsl"
config LSM6DSL_GPIO_IRQ
    int "GPIO Irq Number"
    default 3

config LSM6DSL_GPIO_USERIRQ
    int "GPIO userIrq Number"
    default 0

config SENSOR_TIMESTAMP
	bool "Enable TIMESTAMP in FIFO mode"
    default n
	help
	  "Enable time stamp in sensor Fifo"
endmenu
```

## Platform/ECM3532/M3/hw/sensor_drv/lsm6dsl_dsp/Kconfig
```kconfig
menu "DSP LSM6DSL configuration"
config LSM6DSL_DSP_NAME
    string "Device Name String"
    default "lsm6dsl_dsp"

config SENSOR_TIMESTAMP
	bool "Enable TIMESTAMP in FIFO mode"
  default n
	help
	  "Enable time stamp in sensor Fifo"

endmenu
```

## Platform/ECM3532/M3/hw/sensor_drv/lsm6dsl_fft_dsp/Kconfig
```kconfig
menu "FFT DSP LSM6DSL configuration"
config LSM6DSL_FFT_DSP_NAME
    string "Device Name String"
    default "lsm6dsl_fft_dsp"
endmenu
```

## Platform/ECM3532/M3/hw/sensor_drv/stub_drv/Kconfig
```kconfig
menu "Stub Driver Configuration"
config STUB_DRV_NAME
    string "Device Name String"
    default "stub_drv"
endmenu
```
