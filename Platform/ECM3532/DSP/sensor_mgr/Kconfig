## Platform/ECM3532/DSP/sensor_mgr/Kconfig
```kconfig
menu "Sensor Manager"
config SENSOR_MANAGER
    bool "SENSOR Manager"
    default n
endmenu
```

## Platform/ECM3532/M3/Kconfig
```kconfig
mainmenu "ETA Build Config"

choice SOC
    prompt "SOC"
    comment "Select Target SOC"
    config ECM3532
        bool "ECM3532 SOC"
endchoice

config SOC
    string
    default "ecm3532" if ECM3532

if !BOOTLOADER
choice APPLICATION_TYPE
    prompt "Select application type"
    config STANDALONE_APP
        bool "Standalone application"

    config BOOTLOADER_APP
        bool "Bootloader application"
endchoice
endif

if ECM3532
config CHIP_RAM_START
    hex
    default 0x10000000
config CHIP_RAM_SIZE
    hex
    default 0x40000
config CHIP_RAM_SIZE_INT
    int
    default 262144
config CHIP_RAM_MAX
    hex
    default 0x10040000
config CHIP_FLASH_START
    hex
    default 0x01000000
config CHIP_FLASH_SIZE
    hex
    default 0x80000
config CHIP_FLASH_MAX
    hex
    default 0x01080000
config BOOTLOADER_RAM_START
    hex
    default 0x1003D000
config BOOTLOADER_RAM_SIZE
    hex
    default 0x2060
config BOOTLOADER_HEAP_START
    hex
    default 0x1003F060
config BOOTLOADER_HEAP_SIZE
    int
    default 4000
config APP_MIN_HEAP_SIZE
    int
    default 12288
config BOOTLOADER_APP_FLASH_START
    hex
    default 0x01006000
config BOOTLOADER_APP_FLASH_SIZE
    hex
    default 0x7A000
config DEFAULT_HEAP_SIZE
    int
    default 20000
config BOOTLOADER_FLASH_SIZE
    hex
    default 0x6000

config M3_RAM_SIZE
    hex
    depends on !BOOTLOADER
    range 0x00000 CHIP_RAM_SIZE
    default CHIP_RAM_SIZE
config M3_FLASH_SIZE
    hex
    depends on (STANDALONE_APP || BOOTLOADER_APP) && !BOOTLOADER
    range 0x00000 CHIP_FLASH_SIZE if STANDALONE_APP
    range 0x00000 BOOTLOADER_APP_FLASH_SIZE if BOOTLOADER_APP
    default CHIP_FLASH_SIZE if STANDALONE_APP
    default BOOTLOADER_APP_FLASH_SIZE if BOOTLOADER_APP 

orsource "hw/board/ecm3532/Kconfig"
orsource "hw/csp/ecm3532/Kconfig"
menu "Periphal HAL"
orsource "hw/hal/common/Kconfig"
orsource "hw/hal/ecm3532/Kconfig"
endmenu
orsource "hw/power/ecm3532/Kconfig"
endif
orsource "framework/rpc/Kconfig"
orsource "framework/executor/Kconfig"
orsource "framework/sensor_mgr/Kconfig"
orsource "hw/sensor_drv/Kconfig"
orsource "framework/serial_proto/Kconfig"
orsource "hw/drivers/Kconfig"

menu "Application Menu"
orsource "appKconfig"
endmenu

if !BOOTLOADER
choice LINKER_FILE
    prompt "Select Linker File"
    comment "Data and code resides in RAM, FLASH is not used"
    config RAM_ONLY
        bool "RAM Only"
    comment ""

    comment "Data and code resides in RAM, FLASH is not used, \
16K end of RAM is reserved for IPC"
    config RAM_SHM_ONLY
        bool "RAM only and reserved SHM in RAM"
    comment ""

    comment "Execute from FLASH, Data copied to RAM"
    config FLASH
        bool "FLASH and RAM"
    comment ""

    comment "Execute from FLASH and Data copied to RAM, \
16K end of RAM is reserved for IPC"
    config FLASH_SHM
        bool "FLASH and RAM, with reserved SHM in RAM"
    comment ""

    comment "Boot From Flash and relocate to RAM"
    config FLASH_RELOCATE
        bool "FLASH Boot relocate to RAM"
    comment ""

    comment "Boot From Flash and relocate to RAM, \
Reserve SHM for IPC"
    config FLASH_SHM_RELOCATE
        bool "FLASH Boot relocate to RAM with SHM reserved"
    comment ""
endchoice
endif
choice  BIN_FILE_SECTION
        prompt "Bin Array Section"
        depends on STANDALONE_APP
    config BIN_IN_RODATA
        bool "incbin in text rodata"
    config BIN_IN_BINSECTION
        bool "incbin in flash binSection"
endchoice
config BIN_FILE_SECTION
    string
    default ".rodata" if BIN_IN_RODATA
    default ".binSection" if BIN_IN_BINSECTION

choice DSP_FW_LOC
    depends on (BOOTLOADER_APP && !STANDALONE_APP) && !BOOTLOADER
    prompt "Select DSP location"
    config DSP_IN_FLASH
        bool "DSP in FLASH"
    config DSP_IN_RAM
        bool "DSP in RAM"
endchoice
config DSP_FW_LENGTH
    hex "DSP Length"
    default 0x16000

choice PBUF_LOC
    depends on (BOOTLOADER_APP && !STANDALONE_APP) && !BOOTLOADER
    prompt "Bin Array Section"
    config PBUF_IN_FLASH
        bool "incbin in FLASH"
    config PBUF_IN_RAM
        bool "incbin in RAM"
endchoice
config PBUF_LENGTH
    hex
    depends on (BOOTLOADER_APP && !STANDALONE_APP) && !BOOTLOADER
    default 0x0 if BOOTLOADER_APP

config DSP_FILE_SECTION
    string
    default ".dsp"

config PBUF_FILE_SECTION
    string
    default ".pbuf"

config SHM_LENGTH
    hex
    range 0x1200 0x2000 if (HAL_PDM)
    range 0x200 0x2000 if (!HAL_PDM)
    default 0x1200 if (HAL_PDM)
    default 0x200 if !HAL_PDM
    depends on (FLASH_SHM_RELOCATE || FLASH_SHM || RAM_SHM_ONLY)

config LINKER_FILE
    string
    default "ram" if RAM_ONLY
    default "ram_shm" if RAM_SHM_ONLY
    default "flash" if FLASH
    default "flash_shm" if FLASH_SHM
    default "flash_relocate_to_ram" if FLASH_RELOCATE
    default "flash_shm_relocate_to_ram" if FLASH_SHM_RELOCATE
    default "flash_bootloader" if BOOTLOADER

menu "General Features"
config CLI
    bool "Enable Command Line Interface"
    depends on (UART_0 || UART_1)
    default y

if ECM3532

config SYSTICK_ON_REF_CLK
    bool
    default y if ECM3532
    default n
config SYSTICK_ON_CPU_CLK
    bool
    default n
endif
config TICK_RATE_HZ
    int "Rtos ticks per sec"
    range 1 500  if SYSTICK_ON_REF_CLK
    range 1 1000
    default 500  if SYSTICK_ON_REF_CLK
    default 1000
if SYSTICK_ON_REF_CLK
config SYSTICK_REF_CLOCK
    int
    default 1024
endif

config HEAP_SIZE
    int "FreeRtos HEAP Size In Bytes"
    range BOOTLOADER_HEAP_SIZE BOOTLOADER_HEAP_SIZE if BOOTLOADER
    range APP_MIN_HEAP_SIZE CHIP_RAM_SIZE_INT if BOOTLOADER_APP
    range 0 CHIP_RAM_SIZE_INT if STANDALONE_APP
    default APP_MIN_HEAP_SIZE if BOOTLOADER_APP
    default DEFAULT_HEAP_SIZE if STANDALONE_APP
    default BOOTLOADER_HEAP_SIZE if BOOTLOADER
    comment "Check free heap using FreeHeap command before changing it"

config RTOS_SOFT_TIMER
    bool "RTOS Soft Timer"
    default n

config RTOS_SOFT_TIMER_PEND_CALL
    bool "RTOS Soft Timer Pend Call"
    default n
    depends on RTOS_SOFT_TIMER

config AZURE_IOT_SDK
    bool
    default n
endmenu

orsource "util/packaging/Kconfig"
```

## Platform/ECM3532/M3/framework/executor/Kconfig
```kconfig
menu "Executor library"

config EXECUTOR
    bool "library to enable executor framework"
    default n
endmenu
```

## Platform/ECM3532/M3/framework/rpc/Kconfig
```kconfig
menu "RPC library"

config RPC
    bool "library to enable RPC cross accross processor boundary"
    default n
endmenu
menu "DSP FW Configuations"

config DSP_BACK_DOOR_UART
    bool "enable DSP back door uart"
    depends on RPC  && ECM3531
    default n
config DSP_UART
    bool "enable DSP uart"
    depends on RPC  && ECM3532
    default y


choice PRE_BUILD_DSP_FW
    prompt "Select Pre Build DSP FW"
    depends on RPC
    config DSP_EXECUTOR_FW
      bool "DSP Executor"
      depends on EXECUTOR
    config DSP_PDM_FW
      bool "DSP PDM"
      depends on HAL_PDM
    config DSP_LSM6DSL_FW
      bool "DSP LSM6DS Sensor"
      depends  on (LSM6DSL_DSP && !SENSOR_TIMESTAMP)
    config DSP_LSM6DSL_TS_FW
      bool "DSP LSM6DS Sensor time stamp enabled"
      depends  on (LSM6DSL_DSP && SENSOR_TIMESTAMP)
    config DSP_LSM6DSL_FFT_FW
      bool "DSP LSM6DSL FFT"
      depends on (LSM6DSL_FFT_DSP)
    config DSP_DEFAULT_FW
      bool "DSP Default"
endchoice

config PRE_BUILD_DSP_FW_RELOCATED
    string
    depends on RPC
    default "dsp_fw_executor_relocated.bin" if DSP_EXECUTOR_FW
    default "dsp_fw_pdm_relocated.bin" if DSP_PDM_FW
    default "dsp_fw_lsm6dsl_relocated.bin" if DSP_LSM6DSL_FW
    default "dsp_fw_lsm6dsl_ts_relocated.bin" if DSP_LSM6DSL_TS_FW
    default "dsp_fw_comp_lsm6dsl_fft_relocated.bin" if DSP_LSM6DSL_FFT_FW
    default "dsp_fw_relocated.bin" if DSP_DEFAULT_FW

config PRE_BUILD_DSP_FW
    string
    depends on RPC
    default "dsp_fw_executor.bin" if DSP_EXECUTOR_FW
    default "dsp_fw_pdm.bin" if DSP_PDM_FW
    default "dsp_fw_lsm6dsl.bin" if DSP_LSM6DSL_FW
    default "dsp_fw_lsm6dsl_ts.bin" if DSP_LSM6DSL_TS_FW
    default "dsp_fw_comp_lsm6dsl_fft.bin" if DSP_LSM6DSL_FFT_FW
    default "dsp_fw.bin" if DSP_DEFAULT_FW

choice BUILD_DSP_FW
    prompt "Select DSP Build FW"
    depends on RPC
    config DSP_EXECUTOR
        bool "executor"
    config DSP_HELLO_WORLD
        bool "hello world"
    config DSP_SENSOR
        bool "sensor"
    config DSP_PDM
        bool "pdm fw"
    config DSP_I2C
        bool "i2c"
    config DSP_KERNEL
        bool "kernel"
    config DSP_TIMER
        bool "timer"
    config DSP_MALLOC
        bool "malloc"
endchoice
config BUILD_DSP_FW
    string
    default "hello_world" if DSP_HELLO_WORLD
    default "executor_test" if DSP_EXECUTOR
    default "sensor_test" if DSP_SENSOR
    default "pdm_test" if DSP_PDM
    default "i2c_test" if DSP_I2C
    default "kernel_test" if DSP_KERNEL
    default "timer_test" if DSP_TIMER
    default "malloc_test" if DSP_MALLOC
endmenu
```

## Platform/ECM3532/M3/framework/sensor_mgr/Kconfig
```kconfig
menu "Sensor Manager"
config SENSOR_MANAGER
	bool "SENSOR Manager"
    default n
config SENSOR_DEV_COUNT
    int "Max Sensor count that can be plugged to SM"
    depends on SENSOR_MANAGER
    default 5
endmenu
```

## Platform/ECM3532/M3/framework/serial_proto/Kconfig
```kconfig
menu "Serial Protocol"
config SERIAL_PROTOCOL
	bool "Serial Protocol"
    default n
config DATA_CRC_CHECK
  bool "use CRC for DATA packet"
  depends on SERIAL_PROTOCOL
  default y
choice CRC_TYPE
  prompt "CRC type"
  depends on DATA_CRC_CHECK
  config CRC8
    bool "crc-8"
  config CRC32
  bool "crc-32"
endchoice

config  DATA_PKT_LEN
  int "Max Data pkt len"
  depends on SERIAL_PROTOCOL
  default 100

config SERIAL_XPORT
  bool
  depends on SERIAL_PROTOCOL
  default y
  if SERIAL_PROTOCOL
    orsource "xport/Kconfig"
  endif

endmenu
```

## Platform/ECM3532/M3/framework/serial_proto/xport/Kconfig
```kconfig
config XPORT_UART
  int "UART port for serial xport"
  default 1 if UART_1
  default 0 if UART_0
```
