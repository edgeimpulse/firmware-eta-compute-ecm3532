## Platform/ECM3532/M3/hw/board/ecm3532/evb/Kconfig
```kconfig
menu "Board Configuration"
comment "Select board specific features"

config LPM_LED
	bool "LPM State Indication LED"
    default y
    depends on PM_ENABLE && (HAL_GPIO || HAL_COMMON_GPIO)

config LPM_LED_GPIO
    int "LPM Led GPIO Number"
    default 0
    depends on LPM_LED

endmenu
```

## Platform/ECM3532/M3/hw/drivers/Kconfig
```kconfig
menu "External IO Drivers"
config DISPLAY_NHD0216
	bool "NHD0216 Display Driver"
    depends on EVB_BOARD && I2C_1
    default n
config CAM_HM01B0
	bool "Camera HM01B0 driver"
    default n
    if CAM_HM01B0
    orsource "hm01b0/Kconfig"
    endif
config CAM_HM0360
	bool "Camera HM0360 driver"
    default n
    if CAM_HM0360
    orsource "hm0360/Kconfig"
    endif
config SPI_FLASH
	bool "External SPI Flash"
	depends on (AI_SENSOR_BOARD || AI_VISION_EXTENSION_BOARD || AI_VISION_BOARD) && SPI_1_MASTER
    default y
    if SPI_FLASH
    orsource "spi_flash/Kconfig"
    endif
config ALS_OPT3001
    bool "Ambient Light Sensor"
    depends on (AI_VISION_BOARD || AI_VISION_EXTENSION_BOARD) && I2C_1
    if ALS_OPT3001
    orsource "opt3001/Kconfig"
    endif
config BLE_A31R118
    bool "Ble uart module"
    depends on (AI_VISION_BOARD || AI_SENSOR_BOARD)
    if BLE_A31R118
    orsource "abov/Kconfig"
    endif
endmenu
```

## Platform/ECM3532/M3/hw/drivers/abov/Kconfig
```kconfig
config BLE_UART
    int "a31r118 ble uart port"
    default "0"
config BLE_RST_PIN
    int  "a31r118 ble reset gpio pin"
    depends on (AI_VISION_BOARD || AI_SENSOR_BOARD)
    range 12 12  if AI_VISION_BOARD
    range 16 16  if AI_SENSOR_BOARD
    default 12 if AI_VISION_BOARD
    default 16 if AI_SENSOR_BOARD
```

## Platform/ECM3532/M3/hw/drivers/hm01b0/Kconfig
```kconfig
config STREAMING_MODE
    bool "use streaming mode"
    default y

config HM01B0_I2C_INSTANCE
    int "hm01b0 I2c Instance"
    default "1"
config HM01B0_I2C_ADDRESS
    hex "hm01b0 I2C address"
    default 0x24
config IMAGE_COLUMN_COUNT
    int "Image Column to fill"
    default 256
    range 1 324

config HM01B0_PCLK_GPIO
    int  "hm01b0 PCLK GPIO"
    default 21
config HM01B0_VSYNC_GPIO
    int  "hm01b0 VSYNC GPIO"
    default 30
config HM01B0_HSYNC_GPIO
    int  "hm01b0 HSYNC GPIO"
    default 22
config HM01B0_D0_PIN
    int  "hm01b0 D0 GPIO"
    default 12
```

## Platform/ECM3532/M3/hw/drivers/hm0360/Kconfig
```kconfig
config STREAMING_MODE
    bool "use streaming mode"
    default n

config HM0360_I2C_INSTANCE
    int "hm0360 I2c Instance"
    default "1"

config HM0360_I2C_ADDRESS
    hex "hm0360 I2C address"
    default 0x24

choice
    prompt "camera mode"
    config VGA_MODE
        bool "vga mode"
    config QVGA_MODE
        bool "qvga mode"
    config QQVGA_MODE
        bool "qqvga mode"
endchoice


config IMAGE_COLUMN_COUNT
    int "Image Columns"
    default 320 if (VGA_MODE)
    default 256 if (QVGA_MODE)
    default 96 if (QQVGA_MODE)
    range 1 640 if (VGA_MODE)
    range 1 320 if (QVGA_MODE)
    range 1 160 if (QQVGA_MODE)

config IMAGE_ROW_COUNT
    int "Image Rows"
    default 320 if (VGA_MODE)
    default 240 if (QVGA_MODE)
    default 96 if (QQVGA_MODE)
    range 1 480 if (VGA_MODE)
    range 1 240 if (QVGA_MODE)
    range 1 120 if (QQVGA_MODE)

config HM0360_PCLK_GPIO
    int  "hm0360 PCLK GPIO"
    default 31
config HM0360_VSYNC_GPIO
    int  "hm0360 VSYNC GPIO"
    range 26 26 if (AI_VISION_EXTENSION_BOARD)
    range 30 30 if (AI_VISION_BOARD)
    default 26  if (AI_VISION_EXTENSION_BOARD)
    default 30  if (AI_VISION_BOARD)
config HM0360_HSYNC_GPIO
    int  "hm0360 HSYNC GPIO"
    default 24
config HM0360_D0_PIN
    int  "hm0360 D0 GPIO"
    default 16

choice
    prompt "PCLK Frequency"
    config PCLK_2MHZ
        bool "2MHz"
    config PCLK_1MHZ
        bool "1MHz"
endchoice
```

## Platform/ECM3532/M3/hw/drivers/opt3001/Kconfig
```kconfig
config OPT3001_I2C_INSTANCE
    int "opt3001 I2C Instance"
    default "1"
config OPT3001_I2C_ADDRESS
    hex "opt3001 I2C address"
    default 0x44
config OPT3001_INT_PIN
    int  "opt3001 int GPIO"
    default 1
```

## Platform/ECM3532/M3/hw/drivers/spi_flash/Kconfig
```kconfig
config SPI_FLASH_CS_PIN
    int  "spi flash chip select GPIO"
    range 31 31 if AI_SENSOR_BOARD
    range 30 30 if AI_VISION_EXTENSION_BOARD
    range 26 26 if AI_VISION_BOARD
    default 31 if AI_SENSOR_BOARD
    default 30 if AI_VISION_EXTENSION_BOARD
    default 26 if AI_VISION_BOARD
config SPI_FLASH_SPI_NUM
    int  "spi flash number"
    range 1 1 if (AI_SENSOR_BOARD || AI_VISION_EXTENSION_BOARD)
    range 0 0 if (AI_VISION_BOARD)
    default 1 if (AI_SENSOR_BOARD || AI_VISION_EXTENSION_BOARD)
    default 0 if (AI_VISION_BOARD)
config SPI_FLASH_DEBUG
    bool "Enable / Disable debug logging"
    default 0
choice SPI_FLASH_CHIP
    prompt "Select flash chip"
    config FLASH_MX25R6435F
        bool "MX25R6435F"
endchoice
```

## Platform/ECM3532/M3/hw/hal/common/Kconfig
```kconfig
config HAL_COMMON_UART
	bool "UART HAL"
    default y
	if HAL_COMMON_UART
    orsource "uart/Kconfig"
    endif

config HAL_COMMON_GPIO
	bool "GPIO HAL"
	default y
    if HAL_COMMON_GPIO
    orsource "gpio/Kconfig"
    endif

config HAL_COMMON_TIMER
	bool "TIMER HAL"
	default y
    if HAL_COMMON_TIMER
    orsource "timer/Kconfig"
    endif

config HAL_COMMON_RTC
	bool "RTC HAL"
	default y
    if HAL_COMMON_RTC
    orsource "rtc/Kconfig"
    endif

config HAL_COMMON_I2C
	bool "I2C HAL"
	default y
    if HAL_COMMON_I2C
    orsource "i2c/Kconfig"
    endif

config HAL_COMMON_SPI
	bool "SPI HAL"
	default y
    if HAL_COMMON_SPI
    orsource "spi/Kconfig"
    endif
```

## Platform/ECM3532/M3/hw/hal/common/gpio/Kconfig
```kconfig
menu "GPIO HAL Settings"
config GPIO_PIN_CNT
	int "Default PIN COUNT"
    default 31
config GPIO_MAX_IRQ
	int "GPIO IRQ PIN MAX COUNT"
    default 3
endmenu
```

## Platform/ECM3532/M3/hw/hal/common/i2c/Kconfig
```kconfig
menu "I2C setting"
comment "I2C0 and SPI0 are mutually exclusive"

config I2C_0
	bool "Enable I2C 0"
    depends on !SPI_0_MASTER
choice I2C_0_FREQ
    prompt "I2C0 Freq Choice"
    depends on I2C_0
    config I2C0_FREQ_400_KHZ
        bool "400KHZ"
    config I2C0_FREQ_100_KHZ
        bool "100KHZ"
    config I2C0_FREQ_1_MHZ
        bool "1MHZ"
endchoice
config I2C_0_FREQ
    int
    default 100 if I2C0_FREQ_100_KHZ
    default 400 if I2C0_FREQ_400_KHZ
    default 1000 if I2C0_FREQ_1_MHZ

config I2C_1
	bool "Enable I2C 1"
	default y
choice I2C_1_FREQ
    prompt "I2C1 Freq Choice"
    depends on I2C_1
    config I2C1_FREQ_400_KHZ
        bool "400KHZ"
    config I2C1_FREQ_100_KHZ
        bool "100KHZ"
    config I2C1_FREQ_1_MHZ
        bool "1MHZ"
endchoice
config I2C_1_FREQ
    int
    default 100 if I2C1_FREQ_100_KHZ
    default 400 if I2C1_FREQ_400_KHZ
    default 1000 if I2C1_FREQ_1_MHZ

endmenu
```

## Platform/ECM3532/M3/hw/hal/common/spi/Kconfig
```kconfig
menu "SPI HAL Settings"

config SPI_0_MASTER
    bool "Enable SPI 0 master"
    depends on !I2c_0
    default y
choice SPI_0_BRATE_IN_KHZ
    prompt "Select SPI0 Baud Rate in KHz"
    depends on SPI_0_MASTER
    config SPI_0_BRATE_1000_KHZ
        bool "1000KHZ"
    config SPI_0_BRATE_1600_KHZ
        bool "1600KHZ"
    config SPI_0_BRATE_2000_KHZ
        bool "2000KHZ"
    config SPI_0_BRATE_2600_KHZ
        bool "2600KHZ"
    config SPI_0_BRATE_4000_KHZ
        bool "4000KHZ"
endchoice
config SPI_0_BRATE_IN_KHZ
    int
    default 1000 if SPI_0_BRATE_1000_KHZ
    default 1600 if SPI_0_BRATE_1600_KHZ
    default 2000 if SPI_0_BRATE_2000_KHZ
    default 2600 if SPI_0_BRATE_2600_KHZ
    default 4000 if SPI_0_BRATE_4000_KHZ

config SPI_1_MASTER
    bool "Enable SPI 1 master"
    default y
choice SPI_1_BRATE_IN_KHZ
    prompt "Select SPI1 Baud Rate in KHz"
    depends on SPI_1_MASTER
    config SPI_1_BRATE_1000_KHZ
        bool "1000KHZ"
    config SPI_1_BRATE_1600_KHZ
        bool "1600KHZ"
    config SPI_1_BRATE_2000_KHZ
        bool "2000KHZ"
    config SPI_1_BRATE_2600_KHZ
        bool "2600KHZ"
    config SPI_1_BRATE_4000_KHZ
        bool "4000KHZ"
endchoice
config SPI_1_BRATE_IN_KHZ
    int
    default 1000 if SPI_1_BRATE_1000_KHZ
    default 1600 if SPI_1_BRATE_1600_KHZ
    default 2000 if SPI_1_BRATE_2000_KHZ
    default 2600 if SPI_1_BRATE_2600_KHZ
    default 4000 if SPI_1_BRATE_4000_KHZ
endmenu
```

## Platform/ECM3532/M3/hw/hal/common/timer/Kconfig
```kconfig
menu "Timer menu"
comment "Timer HAL enables support for 64 bit timer"
comment "Select Timer Channel's to be enabled"
config TMR_CH_0
    bool "Timer Channel 0"
    default y

config TMR_CH_1
    bool "Timer Channel 1"
    default n

config TMR_CH_2
    bool "Timer Channel 2"
    default n
endmenu
```

## Platform/ECM3532/M3/hw/hal/common/uart/Kconfig
```kconfig
menu "UART HAL Settings"
comment "UART HAL support, below mentioned are configurable param"


config UART_ASYNC_RECV_MAX_CNT
    int "Max Client that can be registered to receive Async callback"
    default 2
    help
        UART HAL support asynchronous receive of data by registering callback
            with client id, this option define number of such clients
            can be registered

menu "UART 0 Settings"
comment "Uart 0 param"
config UART_0
	bool "Enable UART 0"
	default y
choice UART0_DEFAULT_BAUD_RATE
    prompt "Select UART 0 BAUD Rate"
    depends on UART_0
    config UART0_BRATE_115200
        bool "115200"
    config UART0_BRATE_9600
        bool "9600"
    config UART0_BRATE_38400
        bool "38400"
    config UART0_BRATE_57600
        bool "57600"
    config UART0_BRATE_234000
        bool "234000"
    config UART0_BRATE_460800
        bool "460800"
endchoice
config UART0_DEFAULT_BAUD_RATE
    int
    default 9600   if UART0_BRATE_9600
    default 38400  if UART0_BRATE_38400
    default 57600  if UART0_BRATE_57600
    default 115200 if UART0_BRATE_115200
    default 234000 if UART0_BRATE_234000
    default 460800 if UART0_BRATE_460800

config UART0_DEFAULT_PARITY
	int "Default Parity: 2 for none, 1 for even, 0 for odd"
    default 2
	depends on UART_0

config UART0_DEFAULT_FLOW_CTRL
	int "Default flow Ctrl: 0 for No Flow Ctrl, 1 for HW Flow Ctrl"
    default 0
	depends on UART_0

config UART0_DEFAULT_STOP_BITS
	int "Default Stop Bits: 2"
	depends on UART_0
  default 2
endmenu

menu "UART 1 Settings"
comment "Uart 1 param"
config UART_1
	bool "Enable UART 1"
	default y
choice UART1_DEFAULT_BAUD_RATE
    prompt "Select UART 1 BAUD Rate"
    depends on UART_1
    config UART1_BRATE_115200
        bool "115200"
    config UART1_BRATE_9600
        bool "9600"
    config UART1_BRATE_38400
        bool "38400"
    config UART1_BRATE_57600
        bool "57600"
    config UART1_BRATE_234000
        bool "234000"
    config UART1_BRATE_460800
        bool "460800"
endchoice
config UART1_DEFAULT_BAUD_RATE
    int
    default 9600   if UART1_BRATE_9600
    default 38400  if UART1_BRATE_38400
    default 57600  if UART1_BRATE_57600
    default 115200 if UART1_BRATE_115200
    default 234000 if UART1_BRATE_234000
    default 460800 if UART1_BRATE_460800

config UART1_DEFAULT_PARITY
	int "Default Parity: 2 for none, 1 for even, 0 for odd"
  default 2
	depends on UART_1

config UART1_DEFAULT_FLOW_CTRL
	int "Default flow Ctrl: 0 for No Flow Ctrl, 1 for HW Flow Ctrl"
  default 0
	depends on UART_1

config UART1_DEFAULT_STOP_BITS
	int "Default Stop Bits: 2"
  depends on UART_1
  default 2
endmenu

config UART_CNT
  int
  default 2 if (UART_0 && UART_1)
  default 1 if (UART_0 || UART_1)
config UART_INDEX_OFFSET
  int
  default 0 if (UART_0 && UART_1)
  default 1 if (UART_1)
  default 0 if (UART_0)

config DEBUG_UART_PRINT
    bool "Enable UART print"
    default y

choice DEBUG_UART
  prompt "DEBUG UART"
  depends on (UART_0 || UART_1) && (DEBUG_UART_PRINT)
  config DEBUG_UART_0
    bool "Debug Uart 0"
    depends on (UART_0 && (EVB_BOARD || AI_VISION_EXTENSION_BOARD))
  config DEBUG_UART_1
    bool "Debug Uart 1"
    depends on (UART_1 && (AI_SENSOR_BOARD || EVB_BOARD || AI_VISION_EXTENSION_BOARD || AI_VISION_BOARD))
  endchoice
config DEBUG_UART
  int
  depends on (DEBUG_UART_PRINT)
  default 0 if DEBUG_UART_0
  default 1 if DEBUG_UART_1
endmenu
```

## Platform/ECM3532/M3/hw/hal/ecm3532/Kconfig
```kconfig
config HAL_SPI_SLAVE
	bool "SPI SLAVE"
	default n
    if HAL_SPI_SLAVE
    orsource "spi_slave/Kconfig"
    endif

config HAL_PDM
	bool "Enable PDM"
	default n
    if HAL_PDM
    orsource "pdm/Kconfig"
    endif
```

## Platform/ECM3532/M3/hw/hal/ecm3532/pdm/Kconfig
```kconfig
menu "PDM HAL Settings"

config PDM_0
    bool "Enable PDM 0"
    default n

config PDM_1
    bool "Enable PDM 1"
    default n

config PDM_COUNT
  int
  default 2 if (PDM_0 && PDM_1)
  default 1 if (PDM_0 || PDM_1)
  default 0
config PDM_CLK_SRC
  int
  default 1
config PGA_L
  int  "Lt pga gain -12 to 34.5db 1.5dbstep"
  range 0 31
  default 8

config PGA_R
  int  "Rt pga gain -12 to 34.5db 1.5dbstep"
  range 0 31
  default 8

config HP_FILTER
  bool "enable HP Filter"
  default y

config HP_COEF
  int  "HP filter coefficient"
  depends on HP_FILTER
  range 0  15
  default 11
endmenu
```
