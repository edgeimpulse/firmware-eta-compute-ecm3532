## Applications/Kconfig
```kconfig
menu "Application Selection Menu"
comment "Applications Listing depends on Board Type, HAL Layer, Linker File"
comment "quattro_display depends on TRAVIS_QUATTRO board and SPI 0"
comment "wake word app depends on TRAVIS_QUATTRO, GPIO HAL, SPI HAL and SHM linker files"
comment "timer test depends on Timer Hal"
comment "i2c test depends on I2C and UART HAL"
comment "async test depends on UART HAL"
choice
    prompt "Select Target App"
    config LOAD_TEST
        bool "load_test"
        depends on PM_ENABLE && (HAL_TIMER || HAL_COMMON_TIMER) && (TMR_CH_0 || TMR_CH_1 || TMR_CH_2)
        if LOAD_TEST
            orsource "load_test/Kconfig"
        endif

    config HELLO_WORLD
        bool "hello_world"
        if HELLO_WORLD
            orsource "hello_world/Kconfig"
        endif

    config I2C_TEST
        bool "i2c_test"
        depends on (I2C_1 || I2C_0)
        depends on (HAL_UART || HAL_COMMON_I2C) && (UART_0 || UART_1)
        if I2C_TEST
            orsource "i2c_test/Kconfig"
        endif

    config SPI_TEST
        bool "spi_test"
        depends on (SPI_1_MASTER || SPI_0_MASTER)
        depends on (HAL_SPI || HAL_COMMON_SPI)
        depends on FIJI_BOARD
        if SPI_TEST
            orsource "spi_test/Kconfig"
        endif

    config QUATTRO_DISPLAY
        bool "quattro_display"
        depends on TRAVIS_QUATTRO_BOARD
        depends on HAL_SPI && SPI_0_MASTER

    config TIMER_TEST
        bool "timer_test"
        depends on (HAL_TIMER || HAL_COMMON_TIMER) && (TMR_CH_0 || TMR_CH_1 || TMR_CH_2)
        if TIMER_TEST
            orsource "timer_test/Kconfig"
        endif

    config ASYNC_TEST
        bool "async_test"
        depends on HAL_UART && (UART_0 && UART_1)

    config SENSOR_TEST
        bool "sensor_test"
        depends on SENSOR_MANAGER
        if SENSOR_TEST
            orsource "sensor_test/Kconfig"
        endif

    config SENSOR_PP_FFT
        bool "sensor_post_process_fft"
        depends on SENSOR_MANAGER
        if SENSOR_PP_FFT
            orsource "sensor_pp_fft/Kconfig"
        endif

    config SENSOR_COMPOSITE_FFT
        bool "composite_sensor_test"
        depends on LSM6DSL_FFT_DSP
        if SENSOR_COMPOSITE_FFT
            orsource "composite_sensor_fft/Kconfig"
        endif
    config IOTHUB_CLIENT_SAMPLE_MQTT
        bool "iothub_client_sample_mqtt"
    config WAND
        bool "wand"

endchoice
config TARGET_APP
    string
    default "load_test" if LOAD_TEST
    default "hello_world" if HELLO_WORLD
    default "i2c_test" if I2C_TEST
    default "spi_test" if SPI_TEST
    default "hello_world" if HELLO_WORLD
    default "quattro_display" if QUATTRO_DISPLAY
    default "chao_wakeup_word" if CHAO_WAKEUP_WORD
    default "timer_test" if TIMER_TEST
    default "async_test" if ASYNC_TEST
    default "sensor_test" if SENSOR_TEST
    default "sensor_pp_fft" if SENSOR_PP_FFT
    default "composite_sensor_fft" if SENSOR_COMPOSITE_FFT
    default "wand" if WAND
    default "iothub_client_sample_mqtt" if IOTHUB_CLIENT_SAMPLE_MQTT
endmenu
```

## Applications/edge-impulse-ingestion/Kconfig
```kconfig
menu "Edge Impulse firmware project"
comment "Ingestion / inference firmware for Eta Compute Sensor or Vision board"

orsource "Kernel_config"

endmenu
```

## Platform/ECM3532/DSP/Kconfig
```kconfig
# cool flux DSP build configuration
mainmenu "DSP Build Config"

choice
    prompt "SOC"
    comment "Select Target SOC"
    config DSP_ECM3532
    bool "ECM3532 SOC"
endchoice

config DSP_SOC
    string
    default "ecm3532" if DSP_ECM3532

if DSP_ECM3532
orsource "hw/csp/ecm3532/Kconfig"
endif  ##if ECM3532

orsource "framework/Kconfig"
orsource "sensor_mgr/Kconfig" 
orsource "kernel/Kconfig" 
orsource "executor/Kconfig"
orsource "audio/Kconfig"
orsource "eta_math/Kconfig"

menu "Application Menu"
orsource "appKconfig"

endmenu 

##src packaging options
orsource "packaging/Kconfig"
```

## Platform/ECM3532/DSP/app/eta_math_lib_test/Kconfig
```kconfig
menu "Eta Math Library Test"
comment "Unit test app for Eta Math Library"
endmenu
```

## Platform/ECM3532/DSP/app/executor_test/Kconfig
```kconfig
menu "DSP executor Test"
comment "DSP executor test app, Gets commands from M3 to accelerate a function and then resturns back the results to M3"
endmenu
```

## Platform/ECM3532/DSP/app/hello_world/Kconfig
```kconfig
menu "Hello World"
comment "Hello world test app, simple task periodically prints hello on uart"
endmenu
```

## Platform/ECM3532/DSP/app/i2c_test/Kconfig
```kconfig
menu "I2c unit test"
comment "I2c unit test to check I2c transaction on lsm6dsl sensor"
endmenu
```

## Platform/ECM3532/DSP/app/kernel_test/Kconfig
```kconfig
menu "kernel test"
comment "An application to test various NN kernel implementataion "
endmenu
```

## Platform/ECM3532/DSP/app/malloc_test/Kconfig
```kconfig
menu "malloc test"
comment "An application to test malloc implementataion for both X and Y memory "
endmenu
```

## Platform/ECM3532/DSP/app/pdm_test/Kconfig
```kconfig
menu "PDM Test"
comment "PDM Test app"
    config PDM_TEST
        bool "PDM Test"
        default y
        select PDM
        select PDM_1
endmenu
```

## Platform/ECM3532/DSP/app/sensor_test/Kconfig
```kconfig
menu "DSP Sensor Test"
comment "DSP Sensor test app, Sensors data collection by DSP and transmitted to M3 side"
endmenu
```

## Platform/ECM3532/DSP/eta_math/Kconfig
```kconfig
menu "eta math library"
config ETA_MATH
    bool "eta math functions acceleration on DSP"
    depends on EXECUTOR && FRAMEWORK
    default y
endmenu
```

## Platform/ECM3532/DSP/executor/Kconfig
```kconfig
menu "Executor framework on DSP"
config EXECUTOR
    bool "Executor framework support  on DSP"
    depends on NN_KERNELS && FRAMEWORK
    default n
config EXECUTOR_UNIT_TEST
    depends on EXECUTOR	
    bool "Unit test"
    default n
endmenu
```

## Platform/ECM3532/DSP/framework/Kconfig
```kconfig
menu "dsp framework"

config FRAMEWORK
    bool "DSP frame work based on SHM, globle and local queue"
    default y

config MAX_DSP_LOCAL_QUEUE_SIZE
    depends on FRAMEWORK
    int "select MAX_DSP_LOCAL_QUEUE_SIZE"
    default 8

config MAX_DSP_LOCAL_MSG_DATA_SIZE
    depends on FRAMEWORK
    int "select MAX_DSP_LOCAL_MSG_DATA_SIZE"
    default 2

config DSP_MAX_TASKS
    depends on FRAMEWORK
    int "select DSP_MAX_TASKS"
    default 4

config XMEM_HEAP_SIZE_BYTES
    depends on FRAMEWORK
    int "select XMEM_HEAP_SIZE_BYTES"
    default 4096

config YMEM_HEAP_SIZE_BYTES
    depends on FRAMEWORK
    int "select YMEM_HEAP_SIZE_BYTES"
    default 4096

endmenu
```

## Platform/ECM3532/DSP/hw/csp/ecm3532/Kconfig
```kconfig
menu "Peripheral HAL Settings"
comment "Enable Peripheral HAL support required for APP"

config I2C_2  ##DSP I2c
    bool "Enable I2C 2"
    default y
choice
    prompt "I2C2 Freq Choice"
    depends on I2C_2
    config I2C2_FREQ_400_KHZ
        bool "400KHZ"
    config I2C2_FREQ_100_KHZ
        bool "100KHZ"
    config I2C2_FREQ_1_MHZ
        bool "1MHZ"
endchoice
config I2C_2_FREQ
    int
    default 100 if I2C2_FREQ_100_KHZ
    default 400 if I2C2_FREQ_400_KHZ
    default 1000 if I2C2_FREQ_1_MHZ

config SPI_DSP_MASTER
    bool "Enable SPI DSP master"
    default y
choice
    prompt "Select SPI_DSP Baud Rate in KHz"
    depends on SPI_DSP_MASTER
    config SPI_DSP_BRATE_1000_KHZ
        bool "1000KHZ"
    config SPI_DSP_BRATE_1600_KHZ
        bool "1600KHZ"
    config SPI_DSP_BRATE_2000_KHZ
        bool "2000KHZ"
    config SPI_DSP_BRATE_2600_KHZ
        bool "2600KHZ"
    config SPI_DSP_BRATE_4000_KHZ
        bool "4000KHZ"
endchoice
config SPI_DSP_BRATE_IN_KHZ
    int
    default 1000 if SPI_DSP_BRATE_1000_KHZ
    default 1600 if SPI_DSP_BRATE_1600_KHZ
    default 2000 if SPI_DSP_BRATE_2000_KHZ
    default 2600 if SPI_DSP_BRATE_2600_KHZ
    default 4000 if SPI_DSP_BRATE_4000_KHZ

config SPI_TIMER
    bool "TIMER SPI"
    depends on SPI_DSP_MASTER
    default y
    if SPI_TIMER
        config MAX_TIMERS
        int "No. of SPI based timers"
        default 10 
    endif

 
config DSP_HAL_DMA
    bool "DMA HAL"
    default y
    if DSP_HAL_DMA
    ##orsource "rtc/Kconfig"  ==> As of now there are no parameters for DMA
    endif

config DEBUG_PRINTS
    bool "Enabling Debug trace message through backdoor UART"
    default n



endmenu
```

## Platform/ECM3532/DSP/kernel/Kconfig
```kconfig
menu "NN kernels"
config NN_KERNELS
    bool "Accelerated Neural network kernels on DSP"
    default n
config CONV_RELU_AVGPOOL_2X2
    depends on NN_KERNELS	
    bool "convolve_CHW_q7_ker2x2_stride1_pad0_relu_avgPool_2x2_stride2_pad0"
    default n
config CONV_RELU_AVGPOOL_3X3
    depends on NN_KERNELS
    bool "convolve_CHW_q7_ker3x3_stride1_pad0_relu_avgPool_2x2_stride2_pad0"
    default n
config PW_CONV_FAST
    depends on NN_KERNELS
    bool "eta_pw_conv2d_q7_hwc_2mac_schedule"
    default n
config CONV_RELU_3X3_STRIDE2
    depends on NN_KERNELS
    bool "eta_conv2d_q7_chw_ker3x3_stride2_pad0_relu"
    default n
config CONV_RELU_2X2_STRIDE2
    depends on NN_KERNELS
    bool "eta_conv2d_q7_chw_ker2x2_stride2_pad0_relu"
    default n
config DS_CONV_RELU_2X2_STRIDE2
    depends on NN_KERNELS
    bool "eta_ds_conv2d_q7_chw_ker2x2_stride2_pad0_relu"
    default n
config CONV_RELU_3X3_STRIDE1
    depends on NN_KERNELS
    bool "eta_conv2d_q7_chw_ker3x3_stride1_pad0_relu"
    default n
config DS_CONV_RELU_3X3_STRIDE1
    depends on NN_KERNELS
    bool "eta_ds_conv2d_q7_chw_ker3x3_stride1_pad0_relu"
    default n
config CONV_RELU_3X3_STRIDE1_EX
    depends on NN_KERNELS
    bool "eta_conv2d_q7_chw_ker3x3_stride1_pad0_relu_ex"
    default n


endmenu
```
